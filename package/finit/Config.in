## package/finit/Config.in
```kconfig
config BR2_PACKAGE_FINIT
	bool "finit"
	select BR2_PACKAGE_LIBITE
	select BR2_PACKAGE_LIBUEV
	help
	  Finit is a small event based SysV init replacement with built-in
	  process supervision similar to that of its more famous cousins
	  daemontools and runit. Services are supervised and automatically
	  restarted if they fail.

	  http://troglobit.com/finit.html
```

## package/libuev/Config.in
```kconfig
config BR2_PACKAGE_LIBUEV
	bool "libuev"
	help
	  libuEv is a simple event loop in the style of the more established
	  libevent, libev and the venerable Xt(3) event loop.

	  https://github.com/troglobit/libuev
```

## package/popl/Config.in
```kconfig
config BR2_PACKAGE_POPL
	bool "popl"
	help
	  C++ program options parser library.

	  https://github.com/badaix/popl
```

## package/snapcast/Config.in
```kconfig
config BR2_PACKAGE_SNAPCAST
	bool "snapcast"
	select BR2_PACKAGE_ALSA_LIB
	select BR2_PACKAGE_ASIO
	select BR2_PACKAGE_AVAHI
	select BR2_PACKAGE_AVAHI_DAEMON
	select BR2_PACKAGE_AVAHI_LIBDNSSD_COMPATIBILITY
	select BR2_PACKAGE_FLAC
	select BR2_PACKAGE_POPL
	select BR2_PACKAGE_TREMOR
	help
	  Snapcast is a multi-room client-server audio player, where
	  all clients are time synchronized with the server to play
	  perfectly synced audio.

	  https://github.com/badaix/snapcast
```
